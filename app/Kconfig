## app/Kconfig
```kconfig
# menuconfig LED_SUBSYSTEM
#     bool "LED Subsystem"
#     default y
#     help
#       Enable the LED subsystem and its configuration options.

# if LED_SUBSYSTEM

# menu "LED blink sleep time"

# choice
#     prompt "LED blink sleep time"
#     default BLINK_SLEEP_TIME_1000MS

# config BLINK_SLEEP_TIME_250MS
#     bool "250 ms (fast)"

# config BLINK_SLEEP_TIME_1000MS
#     bool "1s (medium)"

# config BLINK_SLEEP_TIME_2000MS
#     bool "2s (slow)"

# endchoice

# config BLINK_SLEEP_TIME_MS
#     int
#     default 250 if BLINK_SLEEP_TIME_250MS
#     default 1000 if BLINK_SLEEP_TIME_1000MS
#     default 2000 if BLINK_SLEEP_TIME_2000MS

# endmenu


# menuconfig LED_ADVANCED_SETTINGS
#     bool "Advanced LED settings"

# if LED_ADVANCED_SETTINGS

# config LED_BRIGHTNESS
#     int "LED brightness (0-100)"
#     range 0 100
#     default 100

# config LED_FADE_DURATION
#     int "LED fade duration (ms)"
#     default 500

# menuconfig LED_EXPERT_SETTINGS
#     bool "Expert settings"

# if LED_EXPERT_SETTINGS

# config LED_DEBUG
#     bool "Enable LED debugging"

# config LED_CUSTOM_BLINK_PATTERN
#     bool "Custom blink pattern"

# endif

# endif

# endif

config APP_HEARTBEAT_PERIOD_MS
    int "Heartbeat LED period (ms)"
    range 100 2000
    default 500
    help
      Delay between heartbeat LED toggles, in milliseconds.
source "Kconfig.zephyr"
```

## app/boards/my_scratch_board/board.yml
```yaml
board:
  name: my_scratch_board
  full_name: my board from scratch
  vendor: Pranesh
  socs:
    - name: stm32f446xx
```

## app/boards/our_board/board.yml
```yaml
board:
  name: our_board
  full_name: Our board
  vendor: Pranesh Board
  socs:
    - name: stm32f446xx
```
